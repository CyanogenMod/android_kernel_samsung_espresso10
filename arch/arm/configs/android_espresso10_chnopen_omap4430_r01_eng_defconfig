## drivers/misc/modem_if_v2/Kconfig
```kconfig
menuconfig SEC_MODEM_V2
	bool "Samsung Mobile Modem Interface v2"
	default n
	---help---
	  Samsung Modem Interface Driver V2.

config UMTS_MODEM_XMM6262
	bool "modem chip : IMC XMM6262"
	depends on SEC_MODEM_V2
	default n

config LINK_DEVICE_MIPI
	bool "modem driver link device MIPI-HSI"
	depends on SEC_MODEM_V2
	depends on OMAP_HSI
	default n
```

## drivers/misc/mpu3050/Kconfig
```kconfig
menu "Motion Sensors Support"

choice
    bool "Motion Processing Unit"
    depends on I2C
    default MPU_SENSORS_MPU3050_V333

config MPU_NONE
    bool "None"


config MPU_SENSORS_MPU3050_V333
    tristate "MPU3050"
    depends on I2C


endchoice

choice
    prompt "Accelerometer Type"
    depends on MPU_SENSORS_MPU3050_V333
    default MPU_SENSORS_ACCELEROMETER_NONE_V333

config MPU_SENSORS_ACCELEROMETER_NONE_V333
    bool "NONE"
    depends on MPU_SENSORS_MPU3050_V333

endchoice

choice
    prompt "Compass Type"
    depends on MPU_SENSORS_MPU3050_V333
    default MPU_SENSORS_NONE_V333

config MPU_SENSORS_COMPASS_NONE_V333
    bool "NONE"
    depends on MPU_SENSORS_MPU3050_V333

endchoice

choice
    prompt "Pressure Type"
    depends on MPU_SENSORS_MPU3050_V333
    default MPU_SENSORS_BMA085_V333

config MPU_SENSORS_PRESSURE_NONE_V333
    bool "NONE"
    depends on MPU_SENSORS_MPU3050_V333

config MPU_SENSORS_BMA085_V333
    bool "Bosch BMA085"
    depends on MPU_SENSORS_MPU3050_V333

endchoice

config MPU_SENSORS_TIMERIRQ_V333
    tristate "Timer IRQ"

config MPU_SENSORS_DEBUG_V333
    bool "MPU debug"
    depends on MPU_SENSORS_MPU3050_V333 || MPU_SENSORS_TIMERIRQ_V333

endmenu
```

## drivers/phone_svn/Kconfig
```kconfig
#
#
#

menuconfig SAMSUNG_PHONE_SVNET
	tristate "Samsung Phone Interface - SVN"
	default n
	---help---

if SAMSUNG_PHONE_SVNET

menuconfig PHONE_ONEDRAM
	tristate "OneDRAM"
	depends on SAMSUNG_PHONE_SVNET
	default n

config PHONE_IPC_SPI
	bool "IPC SPI"
	depends on SAMSUNG_PHONE_SVNET
	default n

menuconfig PHONE_IPC_HSI
	tristate "IPC HSI"
	depends on SAMSUNG_PHONE_SVNET
	default n

config PHONE_SVNET
	tristate "Samsung Virtual Network"
	depends on SAMSUNG_PHONE_SVNET
	default n

menuconfig PHONE_LOOPBACK_TEST
	tristate "SPI LoopBack Test"
	depends on SAMSUNG_PHONE_SVNET
	default n

menuconfig PHONE_STORAGE
	tristate "DGS Storage"
	depends on SAMSUNG_PHONE_SVNET
	default n

config SVNET_WHITELIST
	bool "svnet uses whitelist via onedram"
	default n

config CHN_CMCC_SPI_SPRD
	tristate "Samsung M0-TD CP SPRD"
	depends on SAMSUNG_PHONE_SVNET
	default n

config WORKQUEUE_FRONT
	tristate "IPC_SPI workqueue front"
	depends on SAMSUNG_PHONE_SVNET
	default n

config FEATURE_SAMSUNG_SPI
	tristate "IPC_SPI protocol"
	depends on SAMSUNG_PHONE_SVNET
	default n

config SPI_LOOPBACK_TEST
	tristate "IPC_SPI loopback test"
	depends on SAMSUNG_PHONE_SVNET
	default n

endif # SAMSUNG_PHONE_SVNET
```

## drivers/sensors/Kconfig
```kconfig
menuconfig ACC_DRIVER_LIS3DH
	bool "Lis3dh sensor Support"
	help
	  Say Y to enable LIS3DH Acceleration Sensor support.
	  This allows control of supported Acceleration Sensor.

menuconfig MAG_DRIVER_YAS532
	bool "yas532 Sensor Support"
	help
	  Say Y to enable YAS532 Magnetic Sensor support.
	  This allows control of supported Magnetic Sensor.

menuconfig INPUT_YAS_SENSORS
	bool "Sensors Support"
	help
	  Say Y to enable Sensors support.  This allows control of supported
	  Sensors.

if INPUT_YAS_SENSORS
source "drivers/sensors/accelerometer/Kconfig"
source "drivers/sensors/geomagnetic/Kconfig"
source "drivers/sensors/orientation/Kconfig"
source "drivers/sensors/optical/Kconfig"
endif # INPUT_YAS_SENSORS

config SENSORS_CORE
         bool "sensors_core"
         depends on I2C
```

## drivers/sensors/optical/Kconfig
```kconfig
config OPTICAL_BH1721
         tristate "Rohm bh1721 Optical Sensor"
         depends on I2C

config OPTICAL_AL3201
         tristate "Rohm bh1721 Optical Sensor"
         depends on I2C
```

## drivers/staging/secvib/Kconfig.sec
```kconfig
config SAMSUNG_VIBETONZ
	tristate "Samsung Haptic touch sense driver(vibetonz)"
	default n
	help
		This driver is based on refernce
		driver provided by
		Immersion Corp.
		touch sense driver(vibetonz)
```

## drivers/video/omap2/displays/Kconfig
```kconfig
menu "OMAP2/3 Display Device Drivers"
        depends on OMAP2_DSS

config PANEL_GENERIC_DPI
        tristate "Generic DPI Panel"
	depends on OMAP2_DSS_DPI
        help
	  Generic DPI panel driver.
	  Supports DVI output for Beagle and OMAP3 SDP.
	  Supports LCD Panel used in TI SDP3430 and EVM boards,
	  OMAP3517 EVM boards and CM-T35.

config PANEL_LGPHILIPS_LB035Q02
	tristate "LG.Philips LB035Q02 LCD Panel"
	depends on OMAP2_DSS_DPI && SPI
	help
	  LCD Panel used on the Gumstix Overo Palo35

config PANEL_SHARP_LS037V7DW01
        tristate "Sharp LS037V7DW01 LCD Panel"
        depends on OMAP2_DSS_DPI
        select BACKLIGHT_CLASS_DEVICE
        help
          LCD Panel used in TI's SDP3430 and EVM boards

config PANEL_NEC_NL8048HL11_01B
	tristate "NEC NL8048HL11-01B Panel"
	depends on OMAP2_DSS_DPI
	help
		This NEC NL8048HL11-01B panel is TFT LCD
		used in the Zoom2/3/3630 sdp boards.

config PANEL_S6E8AA0
        tristate "S6E8AA0 DSI Panel"
        depends on OMAP2_DSS_DSI
        select BACKLIGHT_CLASS_DEVICE
        help
          S6E8AA0 video mode panel.

config PANEL_S6E8AA0A01
        tristate "S6E8AA0A01 DSI Panel"
        depends on OMAP2_DSS_DSI
        select BACKLIGHT_CLASS_DEVICE
        help
          S6E8AA0A01 video mode panel.

config AID_DIMMING
        bool "AID DIMMING"
        depends on OMAP2_DSS_DSI
        default n
        help
         This enables support for Samsung S6E8AA0 MIPI LCD AID DIMMING

config SMART_DIMMING
        bool "SMART DIMMING"
        default n
        help
          This enables support for Samsung S6E8AA0 MIPI LCD SMART DIMMING

config PANEL_TAAL
        tristate "Taal DSI Panel"
        depends on OMAP2_DSS_DSI
        help
          Taal DSI command mode panel from TPO.

config PANEL_TPO_TD043MTEA1
        tristate "TPO TD043MTEA1 LCD Panel"
        depends on OMAP2_DSS_DPI && SPI
        help
          LCD Panel used in OMAP3 Pandora

config PANEL_ACX565AKM
	tristate "ACX565AKM Panel"
	depends on OMAP2_DSS_SDI && SPI
	select BACKLIGHT_CLASS_DEVICE
	help
	  This is the LCD panel used on Nokia N900

config PANEL_TC358765
	tristate "Toshiba TC358765 DSI-2-LVDS chip"
	depends on OMAP2_DSS_DSI && I2C
	select BACKLIGHT_CLASS_DEVICE
	help
	  Toshiba TC358765 DSI-2-LVDS chip with 1024x768 panel

config TC358765_DEBUG
	bool "Toshiba TC358765 DSI-2-LVDS chip debug"
	depends on PANEL_TC358765 && DEBUG_FS
	help
	  Support of TC358765 DSI-2-LVDS chip register access via debugfs

config PANEL_LD9040
	tristate "LD9040 Panel"
	depends on OMAP2_DSS_DPI
	select SPI
	help
		This enables support for Samsung LD9040 LCD panel

config PANEL_LTN070NL01
	tristate "LTN070NL01 Panel"
	depends on OMAP2_DSS_DPI
	default n
	help
		This enables support for Samsung LTN070NL01 LCD panel

config PANEL_LTN101AL03
	tristate "LTN101AL03 Panel"
	depends on OMAP2_DSS_DPI
	default n
	help
		This enables support for Samsung LTN101AL03 LCD panel

config PANEL_HV070WX1
        tristate "HV070W1 DSI Panel"
        depends on OMAP2_DSS_DSI
        select BACKLIGHT_CLASS_DEVICE
        help

config PANEL_NT71391
        tristate "NT71391 DSI Panel"
        depends on OMAP2_DSS_DSI
        select BACKLIGHT_CLASS_DEVICE
        help

config IMGSENSOR_CMC624
	bool "Samsung CMC624"
	depends on FB_OMAP2
	default n
	help
		This enables support for Samsung CMC624 feature

config PANEL_LMS501KF07
	tristate "LMS501KF07 DSI Panel"
	depends on OMAP2_DSS_DSI
	select BACKLIGHT_CLASS_DEVICE
	default n
	help
		This enables support for SMD LMS501KF07 LCD panel.
		HX8369 LDI, MIPI DSI, 800x480, 24bit, and mDNIe.
		Works in Video mode and Initial and DCS commands
		are sent to LDI through separate channel in LP state.

endmenu
```

## fs/exfat/Kconfig
```kconfig
config EXFAT_FS
	tristate "Samsung Open-Sourced exFAT"
	depends on BLOCK
	select NLS_UTF8
	default y
	help
	  exFAT (Extended File Allocation Table) is a Microsoft file system optimized for flash drives.
	  It is supported in Windows XP and later, Mac OS X Snow Leopard from 10.6.5, Mac OSX Lion
	  and OSX Mountain Lion. Also is supported in a number of media devices such as flat panel TVs,
	  media centers, and portable media players.
	  exFAT can be used where the NTFS file system is not a feasible solution, due to data structure overhead,
	  or where the file size limit of the standard FAT32 file system is unacceptable.
	  Unlike NTFS, exFAT cannot pre-allocate disk space for a file by just marking arbitrary space on disk
	  as 'allocated'.

  	  To compile this file system support as a module, choose M here.
  	  The modules will be called exfat_core.ko and exfat_fs.ko
```

## fs/f2fs/Kconfig
```kconfig
config F2FS_FS
	tristate "F2FS filesystem support"
	depends on BLOCK
	default n
	help
	  F2FS is based on Log-structured File System (LFS), which supports
	  versatile "flash-friendly" features. The design has been focused on
	  addressing the fundamental issues in LFS, which are snowball effect
	  of wandering tree and high cleaning overhead.

	  Since flash-based storages show different characteristics according to
	  the internal geometry or flash memory management schemes there are
	  support to various parameters not only for configuring on-disk layout,
	  but also for selecting allocation and cleaning algorithms.

	  If unsure, say N.

config F2FS_STAT_FS
	bool "F2FS Status Information"
	depends on F2FS_FS && DEBUG_FS
	default n
	help
	  /sys/kernel/debug/f2fs/ contains information about all the partitions
	  mounted as f2fs. Each file shows the whole f2fs information.

	  /sys/kernel/debug/f2fs/status includes:
	    - major file system information managed by f2fs currently
	    - average SIT information about whole segments
	    - current memory footprint consumed by f2fs.

config F2FS_FS_XATTR
	bool "F2FS extended attributes"
	depends on F2FS_FS
	default y
	help
	  Extended attributes are name:value pairs associated with inodes by
	  the kernel or by users

	  (see the attr(5) man page, or visit <http://acl.bestbits.at/> for details).

	  If unsure, say N.

config F2FS_FS_POSIX_ACL
	bool "F2FS Access Control Lists"
	depends on F2FS_FS_XATTR
	select FS_POSIX_ACL
	default y
	help
	  Posix Access Control Lists (ACLs) support permissions for users and
	  gourps beyond the owner/group/world scheme.

	  If you don't know what Access Control Lists are, say N

config F2FS_FS_SECURITY
	bool "F2FS Security Labels"
	depends on F2FS_FS_XATTR
	default y
	help
	  Security labels provide an access control facility to support Linux
	  Security Models (LSMs) accepted by SELinux.

	  This option enables an extended attribute handler for file security
	  labels, so that it requires extended attribute support.

	  If you are not using a security module, say N.

config F2FS_CHECK_FS
	bool "F2FS consistency check feature"
	depends on F2FS_FS
	default n
	help
	  Enables BUG_ONs which check the file system consistency in runtime.

	  Enabling this option reduces performance.
```
